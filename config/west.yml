## config/west.yml
```yaml
manifest:
  remotes:
    - name: zmkfirmware
      url-base: https://github.com/zmkfirmware
    - name: tact-software
      url-base: https://github.com/tact-software
    - name: caksoylar
      url-base: https://github.com/caksoylar
  projects:
    - name: zmk
      remote: zmkfirmware
      revision: v0.3-branch
      import: app/west.yml
    # Cygnus 販売元 (Dist16384/zmk-pmw3610-driver) のフォーク。上流の消失・
    # 改変に備えて自アカウントのフォークをコミット固定で参照する。
    # 自動リカバリ (PMW3610_AUTO_RECOVERY) 入りの sayu-hub 系ドライバ。
    # automouse-layer プロパティは使わず、オートマウスは本リポジトリの
    # input-processors (zip_temp_layer) 側で実現する。
    - name: zmk-pmw3610-driver
      remote: tact-software
      revision: c5e190c90bd03dc450105fde12d676bc34e6825e
      path: modules/zmk-pmw3610-driver
    # バッテリー残量・レイヤー状態を RGB LED で表示するウィジェット
    - name: zmk-rgbled-widget
      remote: caksoylar
      revision: v0.3
  self:
    path: config
```
